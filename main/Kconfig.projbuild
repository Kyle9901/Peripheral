## main/Kconfig.projbuild
```kconfig
menu "InstaCare Matter 传感器配置"

    choice INSTACARE_DHT_MODEL
        prompt "DHT 温湿度传感器型号"
        default INSTACARE_DHT_MODEL_DHT11

        config INSTACARE_DHT_MODEL_DHT11
            bool "DHT11"

        config INSTACARE_DHT_MODEL_DHT22
            bool "DHT22/AM2302"
    endchoice

    config INSTACARE_DHT_GPIO
        int "DHT 数据引脚"
        range 0 48
        default 4

    config INSTACARE_PIR_GPIO
        int "HC-SR501 输出引脚"
        range 0 48
        default 5

    config INSTACARE_BH1750_SDA_GPIO
        int "BH1750 I2C SDA 引脚"
        range 0 48
        default 21

    config INSTACARE_BH1750_SCL_GPIO
        int "BH1750 I2C SCL 引脚"
        range 0 48
        default 18
        help
            ESP32-S3 不支持 GPIO22，因此默认使用 GPIO18。

    config INSTACARE_BH1750_ADDRESS
        hex "BH1750 I2C 地址"
        range 0x08 0x77
        default 0x23
        help
            ADDR 接地时为 0x23，ADDR 接高电平时通常为 0x5C。

    config INSTACARE_SENSOR_REPORT_INTERVAL_MS
        int "采样与 Matter 属性更新间隔（毫秒）"
        range 2000 3600000
        default 5000
        help
            DHT11 和 DHT22 的采样间隔均不能小于 2 秒。

    config INSTACARE_OCCUPANCY_HOLD_MS
        int "人体占用默认保持时间（毫秒）"
        range 1000 600000
        default 30000
        help
            PIR 检测到移动后，Occupancy 属性首次启动时保持为有人状态的时长。
            配网后可通过 Matter 的 PIROccupiedToUnoccupiedDelay 属性动态调整，
            调整值由 ESP-Matter 持久化，设备重启后继续生效。
            HC-SR501 只能检测移动，不能检测静止人体，因此建议不少于 30 秒。

endmenu
```

## sdkconfig.defaults
```kconfig
# ESP32-S3 N8R2
CONFIG_IDF_TARGET="esp32s3"
CONFIG_ESPTOOLPY_FLASHSIZE_8MB=y
CONFIG_SPIRAM=y
CONFIG_SPIRAM_MODE_OCT=y
CONFIG_SPIRAM_SPEED_80M=y
CONFIG_SPIRAM_USE_CAPS_ALLOC=y

# USB Serial/JTAG 日志
CONFIG_ESP_CONSOLE_USB_SERIAL_JTAG=y
CONFIG_ESP_CONSOLE_SECONDARY_USB_SERIAL_JTAG=y

# Matter BLE Commissioning 使用 NimBLE
CONFIG_BT_ENABLED=y
CONFIG_BT_NIMBLE_ENABLED=y
CONFIG_BT_BLUEDROID_ENABLED=n
CONFIG_BT_NIMBLE_ENABLE_CONN_REATTEMPT=n

# Matter over Wi-Fi / IPv6
CONFIG_ESP_WIFI_ENABLED=y
CONFIG_ESP_WIFI_SOFTAP_SUPPORT=n
CONFIG_ENABLE_WIFI_AP=n
CONFIG_LWIP_IPV6_AUTOCONFIG=y
CONFIG_LWIP_IPV6_NUM_ADDRESSES=6
CONFIG_LWIP_HOOK_IP6_ROUTE_DEFAULT=y
CONFIG_LWIP_HOOK_ND6_GET_GW_DEFAULT=y
CONFIG_MBEDTLS_HKDF_C=y

# Matter 开发凭据。正式生产时必须替换为每台设备唯一的 DAC/PAI/CD 和配对数据。
CONFIG_EXAMPLE_DAC_PROVIDER=y
CONFIG_EXAMPLE_COMMISSIONABLE_DATA_PROVIDER=y
CONFIG_EXAMPLE_DEVICE_INSTANCE_INFO_PROVIDER=y
CONFIG_DEVICE_VENDOR_ID=0xFFF1
CONFIG_DEVICE_PRODUCT_ID=0x8000
CONFIG_DEVICE_SOFTWARE_VERSION_NUMBER=2

# 8 MiB OTA 分区表
CONFIG_PARTITION_TABLE_CUSTOM=y
CONFIG_PARTITION_TABLE_CUSTOM_FILENAME="partitions.csv"
CONFIG_PARTITION_TABLE_FILENAME="partitions.csv"
CONFIG_PARTITION_TABLE_OFFSET=0xC000

# 当前阶段不启用 Matter OTA Requestor，降低固件和验证复杂度。
CONFIG_ENABLE_OTA_REQUESTOR=n

# 日志和调度
CONFIG_LOG_DEFAULT_LEVEL_INFO=y
CONFIG_LOG_MAXIMUM_LEVEL_INFO=y
CONFIG_FREERTOS_HZ=1000
```
